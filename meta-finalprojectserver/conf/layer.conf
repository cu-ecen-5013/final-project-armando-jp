## meta-finalprojectserver/conf/layer.conf
```bitbake
# We have a conf and classes directory, add to BBPATH
BBPATH .= ":${LAYERDIR}"

# We have recipes-* directories, add to BBFILES
BBFILES += "${LAYERDIR}/recipes-*/*/*.bb \
            ${LAYERDIR}/recipes-*/*/*.bbappend"

BBFILE_COLLECTIONS += "meta-finalprojectserver"
BBFILE_PATTERN_meta-finalprojectserver = "^${LAYERDIR}/"
BBFILE_PRIORITY_meta-finalprojectserver = "6"

LAYERDEPENDS_meta-finalprojectserver = "core"
LAYERSERIES_COMPAT_meta-finalprojectserver = "dunfell"
```

## meta-rootfsoverlay/conf/layer.conf
```bitbake
# We have a conf and classes directory, add to BBPATH
BBPATH .= ":${LAYERDIR}"

# We have recipes-* directories, add to BBFILES
BBFILES += "${LAYERDIR}/recipes-*/*/*.bb \
            ${LAYERDIR}/recipes-*/*/*.bbappend"

BBFILE_COLLECTIONS += "meta-rootfsoverlay"
BBFILE_PATTERN_meta-rootfsoverlay = "^${LAYERDIR}/"
BBFILE_PRIORITY_meta-rootfsoverlay = "6"

LAYERDEPENDS_meta-rootfsoverlay = "core"
LAYERSERIES_COMPAT_meta-rootfsoverlay = "dunfell"
```
